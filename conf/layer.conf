## conf/layer.conf
```bitbake
# We have a conf and classes directory, add to BBPATH
BBPATH .= ":${LAYERDIR}"

# We have recipes-* directories, add to BBFILES
BBFILES += "${LAYERDIR}/recipes-*/*/*.bb \
            ${LAYERDIR}/recipes-*/*/*.bbappend"

BBFILE_COLLECTIONS += "meta-load-enc-ucos"
BBFILE_PATTERN_meta-load-enc-ucos = "^${LAYERDIR}/"
BBFILE_PRIORITY_meta-load-enc-ucos = "6"

require conf/machine/include/imx-base.inc

IMAGE_BOOT_FILES += "key.key zImage"


LAYERDEPENDS_meta-load-enc-ucos = "core"
LAYERSERIES_COMPAT_meta-load-enc-ucos = "hardknott"
```
